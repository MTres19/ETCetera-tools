## Kconfig
```kconfig
#
# For a description of the syntax of this configuration file,
# see the file kconfig-language.txt in the NuttX tools repository.
#

config INDUSTRY_ETCETERA_TOOLS
	tristate "Console utilities for the ETCetera Throttle Controller"
	default n
	select NSH_LIBRARY
	select SYSTEM_READLINE
	---help---
		Enable building the the console utilities (cantest, dynohelper,
		throttle_logdump, drstest).

if INDUSTRY_ETCETERA_TOOLS

config INDUSTRY_ETCETERA_TOOLS_PRIORITY
	int "ETCetera tools thread priority"
	default 100

config INDUSTRY_ETCETERA_TOOLS_STACKSIZE
	int "ETCetera stack size"
	default DEFAULT_TASK_STACKSIZE

endif
```
